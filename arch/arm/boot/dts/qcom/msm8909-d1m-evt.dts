/* Copyright (c) 2014, The Linux Foundation. All rights reserved.
 *
 * This program is free software; you can redistribute it and/or modify
 * it under the terms of the GNU General Public License version 2 and
 * only version 2 as published by the Free Software Foundation.
 *
 * This program is distributed in the hope that it will be useful,
 * but WITHOUT ANY WARRANTY; without even the implied warranty of
 * MERCHANTABILITY or FITNESS FOR A PARTICULAR PURPOSE.  See the
 * GNU General Public License for more details.
 */

/dts-v1/;

#include "msm8909-d1m-evt.dtsi"
#include "msm8909-pm8909.dtsi"
#include "msm8909-pm8909-d1m-evt.dtsi"
#include "msm8909-memory-pstore.dtsi"

/ {
	model = "Qualcomm Technologies, Inc. MSM8909-PM8909 / FIH D1M SKU-ALL 1.0";
	compatible = "qcom,msm8909-fih", "qcom,msm8909", "qcom,cdp";
	qcom,msm-id =	<245 0x0000>, <258 0x0000>,<265 0x0000>, <275 0x0000>;
	qcom,board-id= <0xB1 0>;
};

&soc {
	fih_info_management {
		acdbdir="FAT";
	};
};
