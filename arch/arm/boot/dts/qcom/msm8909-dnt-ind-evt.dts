/* Copyright (c) 2014, The Linux Foundation. All rights reserved.
 *
 * This program is free software; you can redistribute it and/or modify
 * it under the terms of the GNU General Public License version 2 and
 * only version 2 as published by the Free Software Foundation.
 *
 * This program is distributed in the hope that it will be useful,
 * but WITHOUT ANY WARRANTY; without even the implied warranty of
 * MERCHANTABILITY or FITNESS FOR A PARTICULAR PURPOSE.  See the
 * GNU General Public License for more details.
 */

/dts-v1/;

#include "msm8909-fao-evt.dtsi"
#include "msm8909-pm8909.dtsi"
#include "msm8909-pm8909-fao-evt.dtsi"
#include "msm8909-memory-pstore.dtsi"
#include "components/camera/msm8909-camera-flash-fao-dvt-MAX77387.dtsi"
#include "components/camera/msm8909-camera-sensor-dnt-ov8858.dtsi"
#include "components/camera/msm8909-camera-sensor-dnt-s5k5e2.dtsi"

/ {
	model = "Qualcomm Technologies, Inc. MSM8909-PM8909 / FIH FA8/FA9 SKU_IND 1.0";
	compatible = "qcom,msm8909-fih", "qcom,msm8909", "qcom,cdp";
	qcom,msm-id =	<245 0x0000>, <258 0x0000>,<265 0x0000>, <275 0x0000>;
	qcom,board-id= <0xA6 0>;
};

&soc {
	i2c@78b5000 { /* BLSP1 QUP1 */ /* For Gyro */
      /include/ "components/sensors/gsensor_bma2x2_i2c_0x10_v0.dtsi"
			/include/ "components/sensors/ecompass_bmm050_i2c_0x12_v0.dtsi"
			/include/ "components/sensors/alsps_stk3x1x_i2c_0x48_v0.dtsi"
			/include/ "components/sensors/gyro_bmg160_i2c_0x68_v0.dtsi"
	};
};

&soc {
	fih_info_management {
		acdbdir="FAT";
	};
};
