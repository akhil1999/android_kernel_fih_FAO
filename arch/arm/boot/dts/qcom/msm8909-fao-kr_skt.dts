/* Copyright (c) 2014, The Linux Foundation. All rights reserved.
 *
 * This program is free software; you can redistribute it and/or modify
 * it under the terms of the GNU General Public License version 2 and
 * only version 2 as published by the Free Software Foundation.
 *
 * This program is distributed in the hope that it will be useful,
 * but WITHOUT ANY WARRANTY; without even the implied warranty of
 * MERCHANTABILITY or FITNESS FOR A PARTICULAR PURPOSE.  See the
 * GNU General Public License for more details.
 */

/dts-v1/;

#include "msm8909-fao-evt.dtsi"
#include "msm8909-pm8909.dtsi"
#include "msm8909-pm8909-fao-evt.dtsi"
#include "msm8909-memory-pstore.dtsi"

/ {
	model = "Qualcomm Technologies, Inc. MSM8909-PM8909 1GB / FIH FALCON(FOK) SKU_KR-SKT/CN";
	compatible = "qcom,msm8909-fih", "qcom,msm8909", "qcom,cdp";
	qcom,msm-id =	<245 0x1000>, <258 0x1000>,<265 0x1000>, <275 0x1000>;
	qcom,board-id= <0xA2 0>, <0xA4 0>;
};

/*
 * It's for CREQ-14838, FAO-1168
 * SKT only
 */
&pm8909_pon {
			qcom,pon_1 {
				qcom,s2-type = <7>;
			};
};			